/*@!Encoding:1252*/
includes
{
  
}

variables
{
  int count=0;
  }

on start
{
  write("Start block executed");
  write("Read message with id 0x100 and 0x200");
  
}


  
on message 0x100
{
  int i;
  write("Recevied message %X ... Rx node",this.id);
 for(i=0;i<this.dlc;i++)
     write("Byte(%d):%X",i,this.byte(i));

}

on message 0x200
{
  int i;
  write("Recevied message %X  ... Rx node",this.id);
  for(i=0;i<this.dlc;i++)
    write("Byte(%d):%X",i,this.byte(i));
}


on stopMeasurement
{
  write("Stop block executed");
}

